/**
 * @file esp_input.c
 * @brief Input handling for the ESP32-S3 Quake port.
 *
 * - BLE HID keyboards generate Quake key events directly (full keyboard,
 *   usable in the console as well).
 * - BLE HID gamepads (and the optional GPIO buttons) are mapped to a virtual
 *   gamepad, whose buttons generate the same keys used by the MG24 port, so
 *   the default bindings work. Sticks are analog: left = move/strafe,
 *   right = turn/look.
 * - BLE HID mice: buttons are MOUSE1..3, movement turns/looks.
 * - Touch screen: on-screen controls (esp_touch.c) feeding the virtual gamepad.
 * - Board input devices (T-Deck keyboard and trackball, esp_board_tdeck.c).
 *
 * This replaces Sys_SendKeyEvents() and IN_*() of the MG24 vid_sdl.c.
 *
 *  This program is free software; you can redistribute it and/or
 *  modify it under the terms of the GNU General Public License
 *  as published by the Free Software Foundation; either version 2
 *  of the License, or (at your option) any later version.
 */
#include <string.h>
#include "freertos/FreeRTOS.h"
#include "freertos/queue.h"
#include "esp_attr.h"
#include "driver/gpio.h"
#include "quakedef.h"
#include "keyboard.h"
#include "esp_input.h"
#include "esp_board.h"
#include "esp_hid_parser.h"
#include "esp_touch.h"
#include "board_config.h"

#define MAX_HID_FIELDS          64
#define KEY_QUEUE_LENGTH        64
#define STICK_DEADZONE          12      // out of 127
#define STICK_DIGITAL_ON        80      // threshold to use the left stick as arrows in menus
#define STICK_DIGITAL_OFF       40
#define TRIGGER_DIGITAL_ON      96      // out of 255
#define TRIGGER_DIGITAL_OFF     64
#define MOUSE_SCALE             0.5f
#define TOUCH_YAW_PER_PIXEL     0.5f    // degrees per pixel at the default sensitivity (3)
#define TOUCH_PITCH_PER_PIXEL   0.4f

// HID button number (1-based) -> virtual button, "Android" standard layout, used by
// most BLE gamepads (e.g. Xbox Wireless controllers, 8BitDo in D-input/Android mode).
static const int8_t hidButtonMap[16] =
{
    GP_A,       // 1
    GP_B,       // 2
    -1,         // 3 (C)
    GP_X,       // 4
    GP_Y,       // 5
    -1,         // 6 (Z)
    GP_LB,      // 7
    GP_RB,      // 8
    GP_LT,      // 9
    GP_RT,      // 10
    GP_SELECT,  // 11
    GP_START,   // 12
    GP_HOME,    // 13
    GP_L3,      // 14
    GP_R3,      // 15
    -1,         // 16
};
// Keys generated by the virtual gamepad while playing. These are the same keys used on the MG24.
static const uint8_t gpGameKeys[GP_NUM_BUTTONS] =
{
    [GP_A] = K_SPACE,           // jump / swim up
    [GP_B] = 'c',               // swim down
    [GP_X] = '/',               // next weapon
    [GP_Y] = K_TAB,             // scores
    [GP_LB] = ',',              // strafe left
    [GP_RB] = '.',              // strafe right
    [GP_LT] = K_SHIFT,          // run
    [GP_RT] = K_CTRL,           // fire
    [GP_SELECT] = '`',          // console
    [GP_START] = K_ESCAPE,      // menu
    [GP_HOME] = K_ESCAPE,
    [GP_L3] = 'a',              // look up
    [GP_R3] = 'z',              // look down
    [GP_UP] = K_UPARROW,
    [GP_DOWN] = K_DOWNARROW,
    [GP_LEFT] = K_LEFTARROW,
    [GP_RIGHT] = K_RIGHTARROW,
};
// Keys generated while in menus / console
static const uint8_t gpMenuKeys[GP_NUM_BUTTONS] =
{
    [GP_A] = K_ENTER,
    [GP_B] = K_ESCAPE,
    [GP_X] = 'n',
    [GP_Y] = 'y',
    [GP_LB] = K_PGUP,
    [GP_RB] = K_PGDN,
    [GP_LT] = K_SHIFT,
    [GP_RT] = K_ENTER,
    [GP_SELECT] = '`',
    [GP_START] = K_ESCAPE,
    [GP_HOME] = K_ESCAPE,
    [GP_L3] = 0,
    [GP_R3] = 0,
    [GP_UP] = K_UPARROW,
    [GP_DOWN] = K_DOWNARROW,
    [GP_LEFT] = K_LEFTARROW,
    [GP_RIGHT] = K_RIGHTARROW,
};
// HID keyboard usage (page 7) -> Quake key
static const uint8_t hidKeyboardMap[0x68] =
{
    [0x04] = 'a', 'b', 'c', 'd', 'e', 'f', 'g', 'h', 'i', 'j', 'k', 'l', 'm',
    'n', 'o', 'p', 'q', 'r', 's', 't', 'u', 'v', 'w', 'x', 'y', 'z',
    [0x1E] = '1', '2', '3', '4', '5', '6', '7', '8', '9', '0',
    [0x28] = K_ENTER, K_ESCAPE, K_BACKSPACE, K_TAB, K_SPACE, '-', '=', '[', ']', '\\',
    [0x33] = ';', '\'', '`', ',', '.', '/',
    [0x3A] = K_F1, K_F2, K_F3, K_F4, K_F5, K_F6, K_F7, K_F8, K_F9, K_F10, K_F11, K_F12,
    [0x48] = K_PAUSE, K_INS, K_HOME, K_PGUP, K_DEL, K_END, K_PGDN, K_RIGHTARROW, K_LEFTARROW, K_DOWNARROW, K_UPARROW,
    [0x54] = '/', '*', '-', '+', K_ENTER, K_END, K_DOWNARROW, K_PGDN, K_LEFTARROW, '5', K_RIGHTARROW, K_HOME, K_UPARROW,
    K_PGUP, K_INS, K_DEL,
};
static const uint8_t hidModifierMap[8] = { K_CTRL, K_SHIFT, K_ALT, 0, K_CTRL, K_SHIFT, K_ALT, 0 };

typedef struct
{
    uint8_t key;
    uint8_t down;
} keyEvent_t;

static QueueHandle_t keyQueue;
static portMUX_TYPE inputMux = portMUX_INITIALIZER_UNLOCKED;
// HID device state (written by the BLE task, read by the game task)
EXT_RAM_BSS_ATTR static hidField_t hidFields[MAX_HID_FIELDS];
static int numHidFields;
static uint8_t hidKeysDown[32];                 // HID keyboard usages currently pressed
static volatile uint32_t hidGamepadButtons;     // virtual gamepad buttons from HID
static volatile int8_t stickLX, stickLY, stickRX, stickRY;
static volatile uint8_t triggerL, triggerR;
static bool hasRightStickZ;                     // right stick is Z/Rz (Rx/Ry are then triggers)
static float mouseDX, mouseDY;
// Game task state
static uint32_t oldGamepadButtons;
static uint8_t sentKey[GP_NUM_BUTTONS];         // key sent on press, to release the same key
static const int8_t gpioButtons[] =
{
    [GP_UP] = BUTTON_PIN_UP, [GP_DOWN] = BUTTON_PIN_DOWN, [GP_LEFT] = BUTTON_PIN_LEFT, [GP_RIGHT] = BUTTON_PIN_RIGHT,
    [GP_RT] = BUTTON_PIN_FIRE, [GP_A] = BUTTON_PIN_JUMP, [GP_X] = BUTTON_PIN_WEAPON, [GP_START] = BUTTON_PIN_MENU,
    [GP_B] = -1, [GP_Y] = -1, [GP_LB] = -1, [GP_RB] = -1, [GP_LT] = -1, [GP_SELECT] = -1, [GP_HOME] = -1,
    [GP_L3] = -1, [GP_R3] = -1,
};

__attribute__((weak)) void boardInputInit(void)
{
}

__attribute__((weak)) void boardTakeLook(float *dx, float *dy)
{
    *dx = *dy = 0;
}

void inputPushKey(int key, bool down)
{
    if (!key)
        return;
    keyEvent_t e = { key, down };
    xQueueSend(keyQueue, &e, 0);
}

void initKeyboard(void)
{
    keyQueue = xQueueCreate(KEY_QUEUE_LENGTH, sizeof(keyEvent_t));
    uint64_t mask = 0;
    for (int i = 0; i < GP_NUM_BUTTONS; i++)
    {
        if (gpioButtons[i] >= 0)
        {
            mask |= 1ULL << gpioButtons[i];
        }
    }
    if (mask)
    {
        gpio_config_t io = { 0 };
        io.mode = GPIO_MODE_INPUT;
        io.pull_up_en = GPIO_PULLUP_ENABLE;
        io.pin_bit_mask = mask;
        gpio_config(&io);
    }
    touchInit();
    boardInputInit();
}

void getKeys(uint16_t *keys)
{
    uint16_t k = 0;
    for (int i = 0; i < GP_NUM_BUTTONS && i < 16; i++)
    {
        if (gpioButtons[i] >= 0 && !gpio_get_level(gpioButtons[i]))
        {
            k |= 1 << i;
        }
    }
    *keys = k;
}

void getAnalogInput(int32_t *lx, int32_t *ly, int32_t *rx, int32_t *ry)
{
    *lx = stickLX;
    *ly = stickLY;
    *rx = stickRX;
    *ry = stickRY;
}

// ---------------------------------------------------------------------------
// HID
// ---------------------------------------------------------------------------
void inputHidOpened(const uint8_t *const *maps, const uint16_t *mapLengths, int numMaps)
{
    int n = 0;
    for (int m = 0; m < numMaps; m++)
    {
        n = hidParseReportMap(m, maps[m], mapLengths[m], hidFields, n, MAX_HID_FIELDS);
    }
    hasRightStickZ = false;
    for (int i = 0; i < n; i++)
    {
        const hidField_t *f = &hidFields[i];
        if (f->usagePage == HID_PAGE_GENERIC_DESKTOP && (f->flags & HID_FLAG_VARIABLE) && !(f->flags & HID_FLAG_RELATIVE))
        {
            for (int j = 0; j < f->count; j++)
            {
                if (hidGetVariableUsage(f, j) == 0x32 || hidGetVariableUsage(f, j) == 0x35)
                {
                    hasRightStickZ = true;
                }
            }
        }
    }
    numHidFields = n;
    touchHideOverlay();
    printf("HID: %d input fields, right stick on %s\n", n, hasRightStickZ ? "Z/Rz" : "Rx/Ry");
}

bool inputHidHasFields(void)
{
    return numHidFields > 0;
}

static int8_t normalizeAxis(const hidField_t *f, int32_t v)
{
    int32_t range = f->logicalMax - f->logicalMin;
    if (range <= 0)
        return 0;
    int32_t n = (int32_t) (((int64_t) (v - f->logicalMin) * 255) / range) - 128;
    if (n > -STICK_DEADZONE && n < STICK_DEADZONE)
        return 0;
    return n < -128 ? -128 : (n > 127 ? 127 : n);
}

static uint8_t normalizeTrigger(const hidField_t *f, int32_t v)
{
    int32_t range = f->logicalMax - f->logicalMin;
    if (range <= 0)
        return 0;
    int32_t n = (int32_t) (((int64_t) (v - f->logicalMin) * 255) / range);
    return n < 0 ? 0 : (n > 255 ? 255 : n);
}

static void setKeyboardUsage(uint8_t *keys, uint32_t usage)
{
    if (usage < 256)
    {
        keys[usage >> 3] |= 1 << (usage & 7);
    }
}

void inputHidReport(uint8_t mapIndex, uint8_t reportId, const uint8_t *data, int len)
{
    uint8_t newKeys[32] = { 0 };
    bool hasKeyboard = false, hasButtons = false;
    uint32_t buttons = 0;
    uint32_t dpad = 0;
    bool hasDpad = false;
    uint32_t mouseButtons = 0;
    bool isMouse = false;
    for (int i = 0; i < numHidFields; i++)
    {
        const hidField_t *f = &hidFields[i];
        if (f->mapIndex != mapIndex || f->reportId != reportId)
            continue;
        bool variable = f->flags & HID_FLAG_VARIABLE;
        for (int j = 0; j < f->count; j++)
        {
            int32_t v = hidGetFieldValue(f, j, data, len);
            uint32_t usage;
            if (variable)
            {
                usage = hidGetVariableUsage(f, j);
            }
            else
            {
                // array: the value is an index in the usage range
                if (v < f->logicalMin || v > f->logicalMax)
                    continue;
                usage = f->usageMin + (v - f->logicalMin);
                if (!usage)
                    continue;
            }
            switch (f->usagePage)
            {
                case HID_PAGE_KEYBOARD:
                    hasKeyboard = true;
                    if (!variable || v)
                    {
                        setKeyboardUsage(newKeys, usage);
                    }
                    break;
                case HID_PAGE_BUTTON:
                    if (f->flags & HID_FLAG_RELATIVE)
                        break;
                    if (!variable || v)
                    {
                        if (usage >= 1 && usage <= 32)
                        {
                            buttons |= 1u << (usage - 1);
                        }
                    }
                    hasButtons = true;
                    break;
                case HID_PAGE_GENERIC_DESKTOP:
                    if (f->flags & HID_FLAG_RELATIVE)
                    {
                        // mouse
                        isMouse = true;
                        portENTER_CRITICAL(&inputMux);
                        if (usage == 0x30)
                            mouseDX += v;
                        else if (usage == 0x31)
                            mouseDY += v;
                        portEXIT_CRITICAL(&inputMux);
                        if (usage == 0x38 && v)
                        {
                            inputPushKey(v > 0 ? K_MWHEELUP : K_MWHEELDOWN, true);
                            inputPushKey(v > 0 ? K_MWHEELUP : K_MWHEELDOWN, false);
                        }
                        break;
                    }
                    switch (usage)
                    {
                        case 0x30:
                            stickLX = normalizeAxis(f, v);
                            break;
                        case 0x31:
                            stickLY = normalizeAxis(f, v);
                            break;
                        case 0x32:
                            stickRX = normalizeAxis(f, v);
                            break;
                        case 0x35:
                            stickRY = normalizeAxis(f, v);
                            break;
                        case 0x33:
                            if (hasRightStickZ)
                                triggerL = normalizeTrigger(f, v);
                            else
                                stickRX = normalizeAxis(f, v);
                            break;
                        case 0x34:
                            if (hasRightStickZ)
                                triggerR = normalizeTrigger(f, v);
                            else
                                stickRY = normalizeAxis(f, v);
                            break;
                        case 0x39:  // hat switch
                        {
                            static const uint8_t hatToDpad[8] =
                            {
                                1 << (GP_UP - GP_UP), (1 << (GP_UP - GP_UP)) | (1 << (GP_RIGHT - GP_UP)), 1 << (GP_RIGHT - GP_UP),
                                (1 << (GP_DOWN - GP_UP)) | (1 << (GP_RIGHT - GP_UP)), 1 << (GP_DOWN - GP_UP),
                                (1 << (GP_DOWN - GP_UP)) | (1 << (GP_LEFT - GP_UP)), 1 << (GP_LEFT - GP_UP),
                                (1 << (GP_UP - GP_UP)) | (1 << (GP_LEFT - GP_UP)),
                            };
                            hasDpad = true;
                            int32_t d = v - f->logicalMin;
                            if (v >= f->logicalMin && v <= f->logicalMax && d < 8)
                            {
                                dpad |= hatToDpad[d];
                            }
                            break;
                        }
                        case 0x90:  // D-pad as buttons
                        case 0x91:
                        case 0x92:
                        case 0x93:
                        {
                            static const uint8_t dpadBit[4] = { GP_UP - GP_UP, GP_DOWN - GP_UP, GP_RIGHT - GP_UP, GP_LEFT - GP_UP };
                            hasDpad = true;
                            if (v)
                                dpad |= 1 << dpadBit[usage - 0x90];
                            break;
                        }
                        default:
                            break;
                    }
                    break;
                case HID_PAGE_SIMULATION:
                    if (usage == 0xC5)          // brake
                        triggerL = normalizeTrigger(f, v);
                    else if (usage == 0xC4)     // accelerator
                        triggerR = normalizeTrigger(f, v);
                    break;
                case HID_PAGE_CONSUMER:
                    // AC Home / AC Back, used as menu buttons by some gamepads
                    if (variable && (usage == 0x223 || usage == 0x224))
                    {
                        inputPushKey(K_ESCAPE, v != 0);
                    }
                    else if (!variable && (usage == 0x223 || usage == 0x224))
                    {
                        inputPushKey(K_ESCAPE, true);
                        inputPushKey(K_ESCAPE, false);
                    }
                    break;
                default:
                    break;
            }
        }
    }
    if (isMouse && hasButtons)
    {
        // mouse buttons: send directly as MOUSE1..3
        mouseButtons = buttons;
        static uint32_t oldMouseButtons;
        uint32_t changed = mouseButtons ^ oldMouseButtons;
        for (int b = 0; b < 3; b++)
        {
            if (changed & (1 << b))
            {
                inputPushKey(K_MOUSE1 + b, (mouseButtons >> b) & 1);
            }
        }
        oldMouseButtons = mouseButtons;
        hasButtons = false;
    }
    if (hasKeyboard)
    {
        // modifiers are usages 0xE0-0xE7
        for (int m = 0; m < 8; m++)
        {
            int oldDown = (hidKeysDown[0xE0 >> 3] >> m) & 1;
            int newDown = (newKeys[0xE0 >> 3] >> m) & 1;
            if (oldDown != newDown)
            {
                inputPushKey(hidModifierMap[m], newDown);
            }
        }
        for (int u = 0; u < (int) sizeof(hidKeyboardMap); u++)
        {
            int oldDown = (hidKeysDown[u >> 3] >> (u & 7)) & 1;
            int newDown = (newKeys[u >> 3] >> (u & 7)) & 1;
            if (oldDown != newDown)
            {
                inputPushKey(hidKeyboardMap[u], newDown);
            }
        }
        memcpy(hidKeysDown, newKeys, sizeof(hidKeysDown));
    }
    if (hasButtons || hasDpad)
    {
        uint32_t gp = hidGamepadButtons;
        if (hasButtons)
        {
            gp &= ((1u << GP_UP) | (1u << GP_DOWN) | (1u << GP_LEFT) | (1u << GP_RIGHT));
            for (int b = 0; b < 16; b++)
            {
                if ((buttons & (1u << b)) && hidButtonMap[b] >= 0)
                {
                    gp |= 1u << hidButtonMap[b];
                }
            }
        }
        if (hasDpad)
        {
            gp &= ~((1u << GP_UP) | (1u << GP_DOWN) | (1u << GP_LEFT) | (1u << GP_RIGHT));
            gp |= dpad << GP_UP;
        }
        hidGamepadButtons = gp;
    }
}

void inputHidClosed(void)
{
    // release everything
    for (int u = 0; u < 256; u++)
    {
        if (hidKeysDown[u >> 3] & (1 << (u & 7)))
        {
            if (u >= 0xE0 && u <= 0xE7)
                inputPushKey(hidModifierMap[u - 0xE0], false);
            else if (u < (int) sizeof(hidKeyboardMap))
                inputPushKey(hidKeyboardMap[u], false);
        }
    }
    memset(hidKeysDown, 0, sizeof(hidKeysDown));
    numHidFields = 0;
    hidGamepadButtons = 0;
    stickLX = stickLY = stickRX = stickRY = 0;
    triggerL = triggerR = 0;
}

// ---------------------------------------------------------------------------
// Engine interface (game task)
// ---------------------------------------------------------------------------
static uint32_t getVirtualGamepadButtons(bool inMenu)
{
    uint32_t gp = hidGamepadButtons | touchGetButtons();
    for (int i = 0; i < GP_NUM_BUTTONS; i++)
    {
        if (gpioButtons[i] >= 0 && !gpio_get_level(gpioButtons[i]))
        {
            gp |= 1u << i;
        }
    }
    if (boardWakeButtonPressed())
    {
        gp |= 1u << GP_A;       // jump in game, select in menus
    }
    // analog triggers as buttons (with hysteresis)
    static bool lt, rt;
    lt = triggerL > (lt ? TRIGGER_DIGITAL_OFF : TRIGGER_DIGITAL_ON);
    rt = triggerR > (rt ? TRIGGER_DIGITAL_OFF : TRIGGER_DIGITAL_ON);
    if (lt)
        gp |= 1u << GP_LT;
    if (rt)
        gp |= 1u << GP_RT;
    // in menus, the left stick works as arrows
    if (inMenu)
    {
        static uint32_t stickDirs;
        int x = stickLX, y = stickLY;
        uint32_t d = 0;
        d |= (y < -((stickDirs & (1 << GP_UP)) ? STICK_DIGITAL_OFF : STICK_DIGITAL_ON)) << GP_UP;
        d |= (y > ((stickDirs & (1 << GP_DOWN)) ? STICK_DIGITAL_OFF : STICK_DIGITAL_ON)) << GP_DOWN;
        d |= (x < -((stickDirs & (1 << GP_LEFT)) ? STICK_DIGITAL_OFF : STICK_DIGITAL_ON)) << GP_LEFT;
        d |= (x > ((stickDirs & (1 << GP_RIGHT)) ? STICK_DIGITAL_OFF : STICK_DIGITAL_ON)) << GP_RIGHT;
        stickDirs = d;
        gp |= d;
    }
    return gp;
}

void Sys_SendKeyEvents(void)
{
    keyEvent_t e;
    while (keyQueue && xQueueReceive(keyQueue, &e, 0) == pdTRUE)
    {
        Key_Event(e.key, e.down);
    }
    bool inMenu = key_dest != key_game;
    uint32_t gp = getVirtualGamepadButtons(inMenu);
    uint32_t changed = gp ^ oldGamepadButtons;
    for (int i = 0; i < GP_NUM_BUTTONS; i++)
    {
        if (!(changed & (1u << i)))
            continue;
        if (gp & (1u << i))
        {
            sentKey[i] = inMenu ? gpMenuKeys[i] : gpGameKeys[i];
            if (sentKey[i])
                Key_Event(sentKey[i], true);
        }
        else if (sentKey[i])
        {
            Key_Event(sentKey[i], false);
            sentKey[i] = 0;
        }
    }
    oldGamepadButtons = gp;
}

void IN_Init(void)
{
}

void IN_Shutdown(void)
{
}

void IN_Commands(void)
{
}

void IN_Move(usercmd_t *cmd)
{
    if (key_dest != key_game)
    {
        return;
    }
    float mx, my;
    portENTER_CRITICAL(&inputMux);
    mx = mouseDX;
    my = mouseDY;
    mouseDX = mouseDY = 0;
    portEXIT_CRITICAL(&inputMux);
    float tsx, tsy, tdx, tdy;
    touchGetStick(&tsx, &tsy);
    touchTakeLook(&tdx, &tdy);
    float bdx, bdy;
    boardTakeLook(&bdx, &bdy);
    tdx += bdx;
    tdy += bdy;
    float lx = (stickLX + tsx) * sensitivity;
    float ly = (stickLY + tsy) * sensitivity;
    float rx = stickRX * sensitivity + mx * sensitivity * MOUSE_SCALE;
    float ry = stickRY * sensitivity + my * sensitivity * MOUSE_SCALE;
    _g->cl.viewangles[YAW] -= m_yaw * rx + tdx * TOUCH_YAW_PER_PIXEL * sensitivity / 3;
    _g->cl.viewangles[PITCH] += tdy * TOUCH_PITCH_PER_PIXEL * sensitivity / 3;
    if (ry || tdy)
    {
        V_StopPitchDrift();
        _g->cl.viewangles[PITCH] += m_pitch * ry;
        if (_g->cl.viewangles[PITCH] > 80)
            _g->cl.viewangles[PITCH] = 80;
        if (_g->cl.viewangles[PITCH] < -70)
            _g->cl.viewangles[PITCH] = -70;
    }
    cmd->forwardmove -= m_forward * ly;
    cmd->sidemove += m_side * lx;
}
